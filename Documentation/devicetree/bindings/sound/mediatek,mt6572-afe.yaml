## Documentation/devicetree/bindings/sound/mediatek,mt6572-afe.yaml
```yaml
# SPDX-License-Identifier: (GPL-2.0-only OR BSD-2-Clause)
%YAML 1.2
---
$id: http://devicetree.org/schemas/sound/mediatek,mt6572-afe.yaml#
$schema: http://devicetree.org/meta-schemas/core.yaml#

title: MediaTek AFE PCM controller for MT6572

maintainers:
  - Custom Firmware <gabin278@gmail.com>

properties:
  compatible:
    const: mediatek,mt6572-audio

  clocks:
    maxItems: 1

  interrupts:
    maxItems: 1

  iram:
    $ref: /schemas/types.yaml#/definitions/phandle
    description: on-chip audio SRAM used for the DL1 playback buffers.

required:
  - compatible
  - clocks
  - interrupts
  - iram

additionalProperties: false
```

## Documentation/devicetree/bindings/sound/mediatek,mt6572-mt6323.yaml
```yaml
# SPDX-License-Identifier: (GPL-2.0-only OR BSD-2-Clause)
%YAML 1.2
---
$id: http://devicetree.org/schemas/sound/mediatek,mt6572-mt6323.yaml#
$schema: http://devicetree.org/meta-schemas/core.yaml#

title: MediaTek MT6572 sound card with the MT6323 PMIC codec

maintainers:
  - Custom Firmware <gabin278@gmail.com>

description:
  MediaTek MT6572 SoC-based sound card using the MT6323 PMIC analog codec
  for playback, with an optional external speaker amplifier.

allOf:
  - $ref: sound-card-common.yaml#

properties:
  compatible:
    const: mediatek,mt6572-mt6323-sound

  mediatek,platform:
    $ref: /schemas/types.yaml#/definitions/phandle
    description: phandle to the MT6572 AFE platform.

  aux-devs:
    $ref: /schemas/types.yaml#/definitions/phandle-array
    description:
      List of phandles pointing to auxiliary devices, such as an external
      speaker amplifier, to be added to the sound card.

  hp-det-gpios:
    maxItems: 1
    description: Optional headphone-jack plug-detect GPIO.

required:
  - compatible
  - mediatek,platform

unevaluatedProperties: false
```

## drivers/thermal/mediatek/Kconfig
```kconfig
config MTK_THERMAL
	tristate "MediaTek thermal drivers"
	depends on THERMAL_OF
	help
	  This is the option for MediaTek thermal software solutions.
	  Please enable corresponding options to get temperature
	  information from thermal sensors or turn on throttle
	  mechaisms for thermal mitigation.

if MTK_THERMAL

config MTK_SOC_THERMAL
	tristate "AUXADC temperature sensor driver for MediaTek SoCs"
	depends on HAS_IOMEM
	help
	  Enable this option if you want to get SoC temperature
	  information for MediaTek platforms.
	  This driver configures thermal controllers to collect
	  temperature via AUXADC interface.

config MTK_LVTS_THERMAL
        tristate "LVTS Thermal Driver for MediaTek SoCs"
        depends on HAS_IOMEM
        help
          Enable this option if you want to get SoC temperature
          information for supported MediaTek platforms.
          This driver configures LVTS (Low Voltage Thermal Sensor)
          thermal controllers to collect temperatures via ASIF
          (Analog Serial Interface).

config MTK_LVTS_THERMAL_DEBUGFS
       bool "LVTS thermal debugfs"
       depends on MTK_LVTS_THERMAL && DEBUG_FS
       help
         Enable this option to debug the internals of the device driver.

config MTK_PMIC_THERMAL
	tristate "AUXADC temperature sensor driver for MediaTek PMICs"
	depends on MFD_MT6397
	depends on IIO
	help
	  Enable this option if you want to get PMIC temperature
	  information for MediaTek platforms.
	  This driver configures thermal controllers to collect
	  temperature via AUXADC interface.

	  This driver can also be built as a module. If so, the module will be
	  called mtk_pmic_thermal.

endif
```
